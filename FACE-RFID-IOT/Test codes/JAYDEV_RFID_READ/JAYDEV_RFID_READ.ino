#include <SPI.h>
#include <MFRC522.h>
#include <SoftwareSerial.h>

#define SS_PIN 10
#define RST_PIN 9


// JO SUN AA HVE FINAL CODE CHE AMA AME CHENE ARDUINO THI ESP MA DATA NAKHVI DIDHO CHE 
// HVE APDE ONLY AA READER DATA READ KRE ATLE 1 J VAR READ KRVNU CHE OK  :: TASK 1 
// TASK 2 :: JEVU 1 VAKHT SCAN THAY ATLE APDE RFID NI LIGHT JE ESP MA LAKHI HTI N E APDE AMA TRANSFER KRI DESU
// ATLE APDE AHIYA SCAN THAY ATLE LIGHT ON KRAVNU AND WAIT KRVNU CHE JYA SUDHI GREEN LIGHT ON NA THAY TYA SUDHI OK ? JAYDEV
// TASK 3 : ABOVE TASK 2 MA  APDE JE BE 2 LIGHT USE KRI CHE ATTEDANCE STATUS AND RFID_STATUS E BNE LIGHT APDE ARDUINO MA TRANSFER KRI DESU OK
// TASK 4 : FINAL DRASHTI HVE CHENE TU ESP MATHI ARDUINO MA DATA KEVI RITE SEND KRVO E GOT ATLE JO APDE SERVER MATHI REPONSE AVE ATTEDANCE SUCCESSFUL ATLE APDE E CHENE ADUINO N SIGNAL MOKLVANU CHE ATLE E
/// UUPER TASK 2-3 MA JAYDEV GREEN LIGHT ON KRVI SHKE AND RFID PACHU START KRI SHKE TYA SUDHI JAYDEV E RFID N FREEZE KVANU CHE

/// EVERYONE CLEAR ?

// JO HU MARU ANYDESK APU CHU TME CODE KRO TYA HU CHENE ARCHIT SHIKHHA NU PRESENTATION REVIEW KRI LAV OK ?
//JAYDEV DRASHTI SHUBHAM  :: TASKSS....

// PROGRAM KY DEV

// CURRENT PROGRAM CHENE E FINAL CHE ARDUINO MA JE UPLOAD THSE OK

// MAY_04_ESP CHENE E ESP MA CODE UPLOAD KRVNO CODE CHE JE ARDINO JE DATA APSE E RECEIVE KRINE PRINT KRSE OK ?

// MAY04_A CHENE E CODE ARDUINO MATHI ESP NE DATA KY RITE SEND KRVO ENO CODE CHE OK?

// LAST PROGRAM EMPTY CHE JEMA TMRE CODE UPLOAD MA ISSUE AVE N TO BEY VSTU(ESP+ ARDUINO MA BLANK CODE UPLOAD KRVO)

// OKAY ?

MFRC522 mfrc522(SS_PIN, RST_PIN); // Create MFRC522 instance.

void setup()
{
Serial.begin(9600); // Initiate a serial communication

SPI.begin(); // Initiate SPI bus
mfrc522.PCD_Init(); // Initiate MFRC522

Serial.println();
Serial.println("Put your card to the reader for scanning …");
Serial.println(" ");

}


void loop()
{
// Look for new cards
if ( ! mfrc522.PICC_IsNewCardPresent())
{
return;
}
// Select one of the cards
if ( ! mfrc522.PICC_ReadCardSerial())
{
return;
}

//Show UID on serial monitor
Serial.print("UID tag :");
String content= "";

for (byte i = 0; i < mfrc522.uid.size; i++)
{
//Serial.print(mfrc522.uid.uidByte[i] < 0x10 ? " 0" : " ");
//Serial.print(mfrc522.uid.uidByte[i], HEX);
content.concat(String(mfrc522.uid.uidByte[i] < 0x10 ? " 0" : " "));
content.concat(String(mfrc522.uid.uidByte[i], HEX));
}

content.toUpperCase();
Serial.println(content);

}
